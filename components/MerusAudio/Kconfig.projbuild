## components/MerusAudio/Kconfig.projbuild
```kconfig
menu "Merus MA120x0 interface Configuration"
    config MA120X0_NENABLE_PIN
        int "Master enable/disable for ma120x0"
        default 16
        help
            GPIO number to control enable/disable.

    config MA120X0_NMUTE_PIN
        int "Master mute/unmute for ma120x0"
        default 2
        help
            GPIO number to controm mute/unmute.

    config MA120X0_ENABLE_PIN
        int "Master enable/disable for ma120x0"
        default 16
        help
            GPIO number to control enable/disable.

    config MA120X0_NERR_PIN
        int "NERR monitor pin"
        default 21
        help
            GPIO number to monitor NERROR.
              
    config MA120X0_NCLIP_PIN
        int "Clip indication pin"
        default 22
        help
            GPIO number low if clip observed 


    config MA120X0_SCL_PIN
        int "I2C_SCL clock GPIO"
        default 0
        help
            GPIO number to use for I2C clock.

    config MA120X0_SDA_PIN
        int "I2C_SDA data GPIO"
        default 4
        help
            GPIO number to use for I2C data.

    config MA120X0_I2C_ADDR
        hex "I2C ADDR"
        default 0x20
        help
            Address for ma120x0.


endmenu
```

## components/custom_board/Kconfig.projbuild
```kconfig
menu "Custom Audio Board"
    depends on AUDIO_BOARD_CUSTOM

    choice GENERIC_BOARD_DAC
        prompt "DAC chip"
        default DAC_MA120
        help
            Select a DAC connected to the generic ESP32 board

        config DAC_PCM51XX
            bool "TI PCM51XX/TAS57XX based DAC"

        config DAC_MA120
            bool "Infineon MA120 ClassD AMP"

        config DAC_MA120X0
            bool "Infineon MA120X0 ClassD AMP"


    endchoice

	menu "DAC I2C control interface"
    	config DAC_I2C_SDA
        	int "SDA pin"
        	default 21
        	help
        	    I2C SDA pin of the DAC control interface
    	config DAC_I2C_SCL
        	int "SCL pin"
        	default 22
        	help
        	    I2C SCL pin of the DAC control interface
    	config DAC_I2C_ADDR
        	hex "I2C address"
        	default 0x20
        	help
        	    I2C Address of the DAC control interface
    endmenu

	menu "I2S master interface"
        config MASTER_I2S_BCK_PIN
            int "Master i2s bck"
            default 23
            help
                Master audio interface bit clock.

        config MASTER_I2S_LRCK_PIN
            int "Master i2s lrck"
            default 13
            help
                Master audio interface left/right sync clock.

        config MASTER_I2S_DATAOUT_PIN
            int "Master i2s data out"
            default 14
            help
                Master audio interface data out.
    endmenu

	menu "I2S slave interface"

        config SLAVE_I2S_BCK_PIN
            int "Slave i2s bck"
            default 26
            help
                Slave audio interface bit clock.

        config SLAVE_I2S_LRCK_PIN
            int "Slave i2s lrck"
            default 12
            help
                Slave audio interface left/right sync clock.

        config SLAVE_I2S_DATAOUT_PIN
            int "Slave i2s data out"
            default 5
            help
                Slave audio interface data out.
        endmenu

	menu "Merus MA120x0 interface Configuration"
		 depends on DAC_MA120X0

		 config MA120X0_NENABLE_PIN
             int "Master enable/disable for ma120x0"
             default 16
             help
		         GPIO number to control enable/disable.

         config MA120X0_NMUTE_PIN
             int "Master mute/unmute for ma120x0"
             default 2
             help
                 GPIO number to controm mute/unmute.

         config MERUS_NERR_PIN
             int "NERR monitor pin"
             default 21
             help
                 GPIO number to monitor NERROR.

         config MERUS_NCLIP_PIN
             int "Clip indication pin"
             default 22
             help
                 GPIO number low if clip observed
     endmenu

     menu "Merus MA120 interface Configuration"
		 depends on DAC_MA120

		 config MA120_ENABLE_PIN
             int "Master enable/disable for ma120x0"
             default 16
             help
		         GPIO number to control enable/disable.

         config MA120_NMUTE_PIN
             int "Master mute/unmute for ma120x0"
             default 2
             help
                 GPIO number to controm mute/unmute.

         config MERUS_NERR_PIN
             int "NERR monitor pin"
             default 21
             help
                 GPIO number to monitor NERROR.

         config MERUS_NCLIP_PIN
             int "Clip indication pin"
             default 22
             help
                 GPIO number low if clip observed
     endmenu

endmenu
```

## components/dsp_processor/Kconfig.projbuild
```kconfig
# Config file for ESP32 DSP Processor

menu "ESP32 audio buffer and I2S pin config"
    config USE_PSRAM
        bool "Use PSRAM"
        default true
        help
            Need wrover class modules with large SPRAM to have required buffers for Snapcast network delay

    config BITS_PER_SAMPLE
        int "bits per sample output to i2s driver"
        default 32
        help
           Select number of bits per sample for codec configed and connected to esp32 i2s dma hw

    config USE_DSP_SOFT_VOLUME
        bool "Enable software volume control"
        default true
        help
            Required for to change the volume if the I2S module has no volume control.

    config ENABLE_DSP_EFFECTS
        bool "Enable special DSP effects"
        default true
        help
            Requires a few hundred bytes of RAM

    config USE_BIQUAD_ASM
        bool "Use uptimized asm verion of Biquad_f32"
        default true
        help
            Asm version 2 x speed on ESP32 - not working on ESP32-S2

endmenu
```

## components/net_functions/Kconfig.projbuild
```kconfig
menu "SNTP Configuration"

    config SNTP_TIMEZONE
        string "SNTP timezone"
        default "UTC"
        help
            Timezone used for the SNTP configuration.

    config SNTP_SERVER
        string "SNTP server"
        default "pool.ntp.org"
        help
            SNTP server to use to synchronize time from.
endmenu
```

## components/websocket/Kconfig
```kconfig
menu "WebSocket Server"

config WEBSOCKET_SERVER_MAX_CLIENTS
  int "Max clients"
  range 1 1000
  default 20
  help
    Maximum number of clients that the WebSocket
    server can handle at a time.

config WEBSOCKET_SERVER_QUEUE_SIZE
  int "Queue read size"
  range 1 100
  default 10
  help
    Size of the queue to deal with incoming
    WebSocket messages. The queue holds the
    connection, not the actual message.

config WEBSOCKET_SERVER_QUEUE_TIMEOUT
  int "Queue timeout"
  range 0 10000
  default 30
  help
    Timeout for adding new connections to the
    read queue.

config WEBSOCKET_SERVER_TASK_STACK_DEPTH
  int "Stack depth"
  range 3000 20000
  default 6000
  help
    Stack depth for the WebSocket server. The task
    handles reads.

config WEBSOCKET_SERVER_TASK_PRIORITY
  int "Priority"
  range 1 20
  default 5
  help
    Priority for the WebSocket server. The task
    handles reads.

config WEBSOCKET_SERVER_PINNED
  bool "Server pinned to core"
  default false
  help
    Pin the WebSocket server task to a specific core.
    The task handles reads.

config WEBSOCKET_SERVER_PINNED_CORE
  int "Pinned core"
  depends on WEBSOCKET_SERVER_PINNED
  range 0 1
  default 0
  help
    Core that the WebSocket server is pinned to.
    The task handles reads.

endmenu
```

## components/wifi_interface/Kconfig.projbuild
```kconfig
menu "Wifi Configuration"
    config ENABLE_WIFI_PROVISIONING
        bool "enable WiFi profisioning"
        default n
        help
            Enable WiFi provisioning so espressif APP can be used to provison WiFi credentials

    config WIFI_SSID
        string "WiFi SSID"
        default "myssid"
        depends on !ENABLE_WIFI_PROVISIONING
        help
            SSID (network name) for the example to connect to.

    config WIFI_PASSWORD
        string "WiFi Password"
        default "mypassword"
        depends on !ENABLE_WIFI_PROVISIONING
        help
            WiFi password (WPA or WPA2) for the example to use.

    config WIFI_MAXIMUM_RETRY
        int "Maximum retry"
        default 5
        help
            Set the Maximum retry to avoid station reconnecting to the AP unlimited when the AP is really inexistent.
            Set to 0 if unlimited reconnections are preferred.
endmenu
```

## main/Kconfig.projbuild
```kconfig
menu "Snapcast Configuration"

    config SNAPSERVER_USE_MDNS
        bool "Use mDNS"
        default true
        help
            Use mDNS to look for the snapserver to connect to on the local network.

    config SNAPSERVER_HOST
        string "Snapserver host"
        default "192.168.1.158"
        depends on !SNAPSERVER_USE_MDNS
        help
            Host (ip or name) of snapserver to connect to if mDNS is disabled or the mDNS resolution fails.

    config SNAPSERVER_PORT
        int "Snapserver port"
        default 1704
        depends on !SNAPSERVER_USE_MDNS
        help
            Port of the snapserver to connect to.

    config SNAPCLIENT_BUFF_LEN
        int "snapcast protocol buffer len"
        default 4000
        help
            Size of the snapclient protocol messages buffer (in bytes).

    config SNAPCLIENT_NAME
        string "snapclient name"
        default "esp-snapclient"
        help
            Name of the client to register the snapserver.
endmenu

menu "SNTP Configuration"

    config SNPACLIENT_SNTP_ENABLE
        bool "Enable SNTP"
        default true
        help
            Enable the setup of RTC time using the SNTP protocol.
endmenu
```
